## Config.in
```kconfig
# Project-specific packages for the Orange Pi 6 (CIX P1) Nerves system.

menu "CIX P1 accelerator stack"

comment "Out-of-tree kernel modules (built against the configured kernel)"
source "$NERVES_DEFCONFIG_DIR/package/cix-gpu-driver/Config.in"
source "$NERVES_DEFCONFIG_DIR/package/cix-npu-driver/Config.in"
source "$NERVES_DEFCONFIG_DIR/package/cix-vpu-driver/Config.in"

comment "Proprietary userspace runtime blobs"
source "$NERVES_DEFCONFIG_DIR/package/cix-gpu-umd/Config.in"
source "$NERVES_DEFCONFIG_DIR/package/cix-npu-umd/Config.in"
source "$NERVES_DEFCONFIG_DIR/package/cix-noe-umd/Config.in"
source "$NERVES_DEFCONFIG_DIR/package/cix-vpu-firmware/Config.in"
source "$NERVES_DEFCONFIG_DIR/package/cix-gstreamer/Config.in"
source "$NERVES_DEFCONFIG_DIR/package/cix-audio-dsp/Config.in"

endmenu
```

## nerves_defconfig
```kconfig
BR2_aarch64=y
BR2_cortex_a76=y
BR2_TOOLCHAIN_EXTERNAL=y
BR2_TOOLCHAIN_EXTERNAL_CUSTOM=y
BR2_TOOLCHAIN_EXTERNAL_DOWNLOAD=y
BR2_TOOLCHAIN_EXTERNAL_URL="https://github.com/nerves-project/toolchains/releases/download/v15.3.0/nerves_toolchain_aarch64_nerves_linux_gnu-linux_${shell uname -m}-15.3.0-8DAF9F3.tar.xz"
BR2_TOOLCHAIN_EXTERNAL_CUSTOM_PREFIX="aarch64-nerves-linux-gnu"
BR2_TOOLCHAIN_EXTERNAL_HEADERS_6_0=y
BR2_TOOLCHAIN_EXTERNAL_CUSTOM_GLIBC=y
# BR2_TOOLCHAIN_EXTERNAL_INET_RPC is not set
BR2_TOOLCHAIN_EXTERNAL_CXX=y
BR2_TOOLCHAIN_EXTERNAL_FORTRAN=y
BR2_TOOLCHAIN_EXTERNAL_OPENMP=y
BR2_TAR_OPTIONS="--no-same-owner"
BR2_BACKUP_SITE="https://dl.nerves-project.org"
BR2_ENABLE_DEBUG=y
BR2_GLOBAL_PATCH_DIR="${BR2_EXTERNAL_NERVES_PATH}/patches"
BR2_REPRODUCIBLE=y
BR2_ROOTFS_SKELETON_CUSTOM=y
BR2_ROOTFS_SKELETON_CUSTOM_PATH="${BR2_EXTERNAL_NERVES_PATH}/board/nerves-common/skeleton"
BR2_INIT_NONE=y
BR2_ROOTFS_DEVICE_TABLE="${BR2_EXTERNAL_NERVES_PATH}/board/nerves-common/device_table.txt"
# Dynamic /dev via eudev (udev) — required by libinput/weston/cog and started
# by rootfs_overlay/usr/sbin/cix-coldplug.sh (BR2_INIT_NONE has no init).
BR2_ROOTFS_DEVICE_CREATION_DYNAMIC_EUDEV=y
BR2_ENABLE_LOCALE_WHITELIST="locale-archive"
BR2_GENERATE_LOCALE="en_US.UTF-8"
BR2_ROOTFS_OVERLAY="${BR2_EXTERNAL_NERVES_PATH}/board/nerves-common/rootfs_overlay ${NERVES_DEFCONFIG_DIR}/rootfs_overlay"
BR2_ROOTFS_POST_BUILD_SCRIPT="${NERVES_DEFCONFIG_DIR}/post-build.sh ${BR2_EXTERNAL_NERVES_PATH}/board/nerves-common/post-build.sh"
BR2_ROOTFS_POST_IMAGE_SCRIPT="${NERVES_DEFCONFIG_DIR}/post-createfs.sh"
BR2_LINUX_KERNEL=y
BR2_LINUX_KERNEL_CUSTOM_TARBALL=y
BR2_LINUX_KERNEL_CUSTOM_TARBALL_LOCATION="https://github.com/orangepi-xunlong/linux-orangepi/archive/f41a4f0b22c0f85a645aa207435761a0123feeaf.tar.gz"
BR2_LINUX_KERNEL_USE_CUSTOM_CONFIG=y
BR2_LINUX_KERNEL_CUSTOM_CONFIG_FILE="${NERVES_DEFCONFIG_DIR}/linux-6.6-cix.config"
BR2_LINUX_KERNEL_INSTALL_TARGET=y
BR2_LINUX_KERNEL_NEEDS_HOST_OPENSSL=y
BR2_LINUX_KERNEL_NEEDS_HOST_LIBELF=y
BR2_PACKAGE_BUSYBOX_CONFIG="${BR2_EXTERNAL_NERVES_PATH}/board/nerves-common/busybox.config"
BR2_PACKAGE_LINUX_FIRMWARE=y
BR2_PACKAGE_LINUX_FIRMWARE_RTL_8169=y
BR2_PACKAGE_LIBMNL=y
BR2_PACKAGE_LIBNL=y
BR2_PACKAGE_E2FSPROGS=y
BR2_PACKAGE_GPTFDISK=y
BR2_PACKAGE_GPTFDISK_SGDISK=y
# BR2_PACKAGE_E2FSPROGS_FSCK is not set
BR2_PACKAGE_CA_CERTIFICATES=y
# BR2_TARGET_ROOTFS_TAR is not set
BR2_TARGET_GRUB2=y
BR2_TARGET_GRUB2_BUILTIN_MODULES_EFI="boot linux ext2 fat squash4 part_gpt part_msdos normal efi_gop loadenv echo test true search configfile regexp probe"
BR2_PACKAGE_HOST_DOSFSTOOLS=y
BR2_NERVES_SYSTEM_NAME="nerves_system_orangepi6"
BR2_NERVES_ADDITIONAL_IMAGE_FILES="${NERVES_DEFCONFIG_DIR}/fwup.conf"

# --- CIX P1 accelerator stack (Milestone 1: kernel modules + runtime blobs) ---
# Out-of-tree kernel modules built against the configured kernel.
BR2_PACKAGE_CIX_GPU_DRIVER=y
BR2_PACKAGE_CIX_NPU_DRIVER=y
BR2_PACKAGE_CIX_VPU_DRIVER=y
# Proprietary userspace runtime blobs. libmali requires libdrm + wayland
# at runtime (DT_NEEDED); cix-gpu-umd also selects them.
BR2_PACKAGE_LIBDRM=y
BR2_PACKAGE_WAYLAND=y
BR2_PACKAGE_CIX_GPU_UMD=y
BR2_PACKAGE_CIX_NPU_UMD=y
BR2_PACKAGE_CIX_NOE_UMD=y
BR2_PACKAGE_CIX_VPU_FIRMWARE=y
BR2_PACKAGE_CIX_AUDIO_DSP=y
BR2_PACKAGE_CIX_GSTREAMER=y

# --- Display / GPU (M2) ---
# cix-gpu-umd provides EGL/GLES via libglvnd dispatch and is the libgbm
# provider; weston runs on DRM with the desktop or kiosk shell, seatd
# builtin backend (weston runs as root, no seat daemon).
BR2_PACKAGE_WESTON=y
BR2_PACKAGE_WESTON_DEFAULT_DRM=y
BR2_PACKAGE_WESTON_DRM=y
BR2_PACKAGE_WESTON_SHELL_DESKTOP=y
BR2_PACKAGE_WESTON_SHELL_KIOSK=y
BR2_PACKAGE_WESTON_DEMO_CLIENTS=y
BR2_PACKAGE_KMSCUBE=y

# --- Audio ---
BR2_PACKAGE_ALSA_LIB=y
BR2_PACKAGE_ALSA_UTILS=y
BR2_PACKAGE_ALSA_UTILS_ALSACTL=y
BR2_PACKAGE_ALSA_UTILS_ALSAMIXER=y
BR2_PACKAGE_ALSA_UTILS_ALSAUCM=y
BR2_PACKAGE_ALSA_UTILS_AMIXER=y
BR2_PACKAGE_ALSA_UTILS_APLAY=y
BR2_PACKAGE_ALSA_UTILS_SPEAKER_TEST=y

# --- Multimedia: GStreamer 1.24 + ffmpeg ---
BR2_PACKAGE_GSTREAMER1=y
BR2_PACKAGE_GSTREAMER1_INSTALL_TOOLS=y
BR2_PACKAGE_GST1_PLUGINS_BASE=y
BR2_PACKAGE_GST1_PLUGINS_BASE_PLUGIN_ALSA=y
BR2_PACKAGE_GST1_PLUGINS_BASE_PLUGIN_APP=y
BR2_PACKAGE_GST1_PLUGINS_BASE_PLUGIN_AUDIOCONVERT=y
BR2_PACKAGE_GST1_PLUGINS_BASE_PLUGIN_AUDIORESAMPLE=y
BR2_PACKAGE_GST1_PLUGINS_BASE_PLUGIN_AUDIOTESTSRC=y
BR2_PACKAGE_GST1_PLUGINS_BASE_PLUGIN_OGG=y
BR2_PACKAGE_GST1_PLUGINS_BASE_PLUGIN_OPUS=y
BR2_PACKAGE_GST1_PLUGINS_BASE_PLUGIN_PLAYBACK=y
BR2_PACKAGE_GST1_PLUGINS_BASE_PLUGIN_RAWPARSE=y
BR2_PACKAGE_GST1_PLUGINS_BASE_PLUGIN_TCP=y
BR2_PACKAGE_GST1_PLUGINS_BASE_PLUGIN_TYPEFIND=y
BR2_PACKAGE_GST1_PLUGINS_BASE_PLUGIN_VIDEOCONVERTSCALE=y
BR2_PACKAGE_GST1_PLUGINS_BASE_PLUGIN_VIDEOTESTSRC=y
BR2_PACKAGE_GST1_PLUGINS_BASE_PLUGIN_VOLUME=y
BR2_PACKAGE_GST1_PLUGINS_BASE_PLUGIN_VORBIS=y
# GL library: GLES2 API + EGL platform + wayland window (no X11).
BR2_PACKAGE_GST1_PLUGINS_BASE_LIB_OPENGL=y
BR2_PACKAGE_GST1_PLUGINS_BASE_LIB_OPENGL_GLES2=y
BR2_PACKAGE_GST1_PLUGINS_BASE_LIB_OPENGL_EGL=y
BR2_PACKAGE_GST1_PLUGINS_BASE_LIB_OPENGL_WAYLAND=y
BR2_PACKAGE_GST1_PLUGINS_GOOD=y
BR2_PACKAGE_GST1_PLUGINS_GOOD_JPEG=y
BR2_PACKAGE_GST1_PLUGINS_GOOD_PNG=y
BR2_PACKAGE_GST1_PLUGINS_GOOD_PLUGIN_AUDIOPARSERS=y
BR2_PACKAGE_GST1_PLUGINS_GOOD_PLUGIN_AUTODETECT=y
BR2_PACKAGE_GST1_PLUGINS_GOOD_PLUGIN_ISOMP4=y
BR2_PACKAGE_GST1_PLUGINS_GOOD_PLUGIN_MATROSKA=y
BR2_PACKAGE_GST1_PLUGINS_GOOD_PLUGIN_RTP=y
BR2_PACKAGE_GST1_PLUGINS_GOOD_PLUGIN_RTPMANAGER=y
BR2_PACKAGE_GST1_PLUGINS_GOOD_PLUGIN_RTSP=y
BR2_PACKAGE_GST1_PLUGINS_GOOD_PLUGIN_UDP=y
BR2_PACKAGE_GST1_PLUGINS_GOOD_PLUGIN_V4L2=y
BR2_PACKAGE_GST1_PLUGINS_GOOD_PLUGIN_V4L2_PROBE=y
# Webcams: uvcvideo is in-kernel (=m, USB autoload); v4l2-ctl & friends for
# probing/controls, libv4l for format conversion.
BR2_PACKAGE_LIBV4L=y
BR2_PACKAGE_LIBV4L_UTILS=y
BR2_PACKAGE_GST1_PLUGINS_GOOD_PLUGIN_VIDEOFILTER=y
BR2_PACKAGE_GST1_PLUGINS_BAD=y
BR2_PACKAGE_GST1_PLUGINS_BAD_PLUGIN_DEBUGUTILS=y
BR2_PACKAGE_GST1_PLUGINS_BAD_PLUGIN_GL=y
BR2_PACKAGE_GST1_PLUGINS_BAD_PLUGIN_KMS=y
BR2_PACKAGE_GST1_PLUGINS_BAD_PLUGIN_MPEGTSDEMUX=y
BR2_PACKAGE_GST1_PLUGINS_BAD_PLUGIN_MPEGTSMUX=y
BR2_PACKAGE_GST1_PLUGINS_BAD_PLUGIN_V4L2CODECS=y
BR2_PACKAGE_GST1_PLUGINS_BAD_PLUGIN_VIDEOPARSERS=y
BR2_PACKAGE_GST1_PLUGINS_BAD_PLUGIN_WAYLAND=y
# Software codec fallback + `ffmpeg` CLI for conversion jobs.
BR2_PACKAGE_GST1_LIBAV=y
BR2_PACKAGE_FFMPEG=y
BR2_PACKAGE_FFMPEG_GPL=y
BR2_PACKAGE_FFMPEG_FFMPEG=y
BR2_PACKAGE_FFMPEG_FFPROBE=y
BR2_PACKAGE_FFMPEG_SWSCALE=y

# --- WiFi (M.2 E-key module; Orange Pi ships RTL8852BE -> rtw89) ---
BR2_PACKAGE_LINUX_FIRMWARE_RTL_RTW88=y
BR2_PACKAGE_LINUX_FIRMWARE_RTL_RTW89=y
BR2_PACKAGE_IW=y
BR2_PACKAGE_WIRELESS_REGDB=y
BR2_PACKAGE_WPA_SUPPLICANT=y
BR2_PACKAGE_WPA_SUPPLICANT_NL80211=y
BR2_PACKAGE_WPA_SUPPLICANT_AP_SUPPORT=y
BR2_PACKAGE_WPA_SUPPLICANT_EAP=y
BR2_PACKAGE_WPA_SUPPLICANT_HOTSPOT=y
BR2_PACKAGE_WPA_SUPPLICANT_DEBUG_SYSLOG=y
BR2_PACKAGE_WPA_SUPPLICANT_WPS=y
BR2_PACKAGE_WPA_SUPPLICANT_WPA3=y
BR2_PACKAGE_WPA_SUPPLICANT_CLI=y
BR2_PACKAGE_WPA_SUPPLICANT_PASSPHRASE=y

# --- Bluetooth (RTL8852BE BT is USB HCI; btusb + BT_RTL in-kernel) ---
BR2_PACKAGE_LINUX_FIRMWARE_RTL_88XX_BT=y
BR2_PACKAGE_BLUEZ5_UTILS=y
BR2_PACKAGE_BLUEZ5_UTILS_CLIENT=y
BR2_PACKAGE_BLUEZ5_UTILS_TOOLS=y

BR2_PACKAGE_NBTTY=y
BR2_PACKAGE_ERLANG_28=y
BR2_PACKAGE_NERVES_CONFIG=y
BR2_PACKAGE_NERVES_CONFIG_ACCEPT_RNG_NOTICE=y
```

## package/cix-audio-dsp/Config.in
```kconfig
config BR2_PACKAGE_CIX_AUDIO_DSP
	bool "cix-audio-dsp"
	depends on BR2_aarch64
	help
	  CIX audio DSP firmware + offload codecs (proprietary CIX runtime blob, install-only).
```

## package/cix-gpu-driver/Config.in
```kconfig
config BR2_PACKAGE_CIX_GPU_DRIVER
	bool "cix-gpu-driver"
	depends on BR2_LINUX_KERNEL
	depends on BR2_aarch64
	help
	  Out-of-tree ARM Mali "sky1" GPU kernel driver for the CIX P1
	  (Immortalis-G720): mali_kbase.ko + memory_group_manager.ko +
	  protected_memory_allocator.ko. Built against the configured
	  Linux kernel. Pair with the cix-gpu-umd userspace package.
```

## package/cix-gpu-umd/Config.in
```kconfig
config BR2_PACKAGE_CIX_GPU_UMD
	bool "cix-gpu-umd"
	depends on BR2_aarch64
	depends on BR2_TOOLCHAIN_USES_GLIBC
	depends on BR2_INSTALL_LIBSTDCPP
	depends on BR2_TOOLCHAIN_HAS_THREADS # wayland
	# libmali.so DT_NEEDEDs libdrm.so.2, libwayland-client.so.0 and
	# libwayland-server.so.0 — without these the blob fails to dlopen.
	select BR2_PACKAGE_LIBDRM
	select BR2_PACKAGE_WAYLAND
	# Build-time GL provider wiring: libglvnd is the linkable EGL/GLES
	# dispatch (weston/gst-gl/kmscube link it); at runtime it dispatches
	# to the libEGL_cix ICD via /usr/share/glvnd/egl_vendor.d/40_cix.json.
	select BR2_PACKAGE_LIBGLVND
	select BR2_PACKAGE_LIBGLVND_DISPATCH_EGL
	select BR2_PACKAGE_LIBGLVND_DISPATCH_GLES
	# The blob ships a full-featured libgbm (modifiers2, fd_for_plane) —
	# this package is the Buildroot libgbm provider (gbm.h/gbm.pc staged).
	select BR2_PACKAGE_HAS_LIBGBM
	select BR2_PACKAGE_LIBGBM_HAS_FEATURE_FORMAT_MODIFIER_PLANE_COUNT
	select BR2_PACKAGE_LIBGBM_HAS_FEATURE_DMA_BUF
	help
	  Proprietary ARM Mali "libmali" userspace for the CIX P1
	  Immortalis-G720 (EGL / OpenGL ES / GBM / OpenCL / Vulkan) plus the
	  mali_csffw.bin GPU firmware. Runtime install under /opt/cixgpu-pro
	  with /usr/lib symlinks (Nerves has no ldconfig). Provides the
	  Buildroot libgbm virtual package and the libglvnd EGL/GLES vendor
	  ICD, so weston/gst-gl/kmscube build and run against the GPU.
	  Pair with cix-gpu-driver.

config BR2_PACKAGE_PROVIDES_LIBGBM
	default "cix-gpu-umd" if BR2_PACKAGE_CIX_GPU_UMD
```

## package/cix-gstreamer/Config.in
```kconfig
config BR2_PACKAGE_CIX_GSTREAMER
	bool "cix-gstreamer"
	depends on BR2_aarch64
	depends on BR2_PACKAGE_GSTREAMER1
	depends on BR2_PACKAGE_GST1_PLUGINS_BASE
	# Runtime DT_NEEDED of the installed blob plugins:
	#  fdkaac -> libfdk-aac.so.2, kms -> libdrm.so.2,
	#  va -> libva.so.2 + libgudev-1.0.so.0, cixsr -> libnoe.so
	select BR2_PACKAGE_FDK_AAC
	select BR2_PACKAGE_LIBDRM
	select BR2_PACKAGE_LIBVA
	select BR2_PACKAGE_LIBGUDEV
	select BR2_PACKAGE_CIX_NOE_UMD
	help
	  CIX hardware-accelerated GStreamer plugins (V4L2 M2M VPU decode,
	  KMS/VA sinks, cixsr super-resolution). Proprietary CIX runtime blob,
	  install-only. Built against GStreamer 1.22; runs on the system's
	  1.24 libs (plugin ABI is backward compatible). The X11-only blob
	  plugins (gtk, opengl) and the blob's private 1.22 copies of
	  libgstgl/libgstvideo are not installed.
```

## package/cix-noe-umd/Config.in
```kconfig
config BR2_PACKAGE_CIX_NOE_UMD
	bool "cix-noe-umd"
	depends on BR2_aarch64
	select BR2_PACKAGE_CIX_NPU_UMD
	help
	  CIX NOE NPU runtime (libnoe) — high-level inference API on top of
	  the AIPU userspace driver. Proprietary CIX runtime blob, install-only.
```

## package/cix-npu-driver/Config.in
```kconfig
config BR2_PACKAGE_CIX_NPU_DRIVER
	bool "cix-npu-driver"
	depends on BR2_LINUX_KERNEL
	depends on BR2_aarch64
	help
	  Out-of-tree ArmChina Zhouyi V3 NPU (AIPU) kernel driver for the
	  CIX P1: aipu.ko (device node /dev/aipu). Built against the
	  configured Linux kernel. Pair with cix-npu-umd / cix-noe-umd.
```

## package/cix-npu-umd/Config.in
```kconfig
config BR2_PACKAGE_CIX_NPU_UMD
	bool "cix-npu-umd"
	depends on BR2_aarch64
	help
	  ArmChina AIPU NPU userspace (libaipudrv) (proprietary CIX runtime blob, install-only).
```

## package/cix-vpu-driver/Config.in
```kconfig
config BR2_PACKAGE_CIX_VPU_DRIVER
	bool "cix-vpu-driver"
	depends on BR2_LINUX_KERNEL
	depends on BR2_aarch64
	select BR2_PACKAGE_HOST_SCONS
	help
	  Out-of-tree ARM Linlon-V8 (MVE) VPU kernel driver for the CIX P1:
	  amvx.ko, a V4L2 M2M video decoder/encoder. Built with scons
	  against the configured Linux kernel. Pair with cix-vpu-firmware
	  and cix-gstreamer.
```

## package/cix-vpu-firmware/Config.in
```kconfig
config BR2_PACKAGE_CIX_VPU_FIRMWARE
	bool "cix-vpu-firmware"
	depends on BR2_aarch64
	help
	  CIX Linlon-V8 VPU codec firmware (.fwb) (proprietary CIX runtime blob, install-only).
```
